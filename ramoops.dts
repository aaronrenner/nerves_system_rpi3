/dts-v1/;
/plugin/;

/ {
	compatible = "brcm,bcm2835";

	fragment@0 {
		target-path = "/";
		__overlay__ {
			reserved-memory {
				#address-cells = <1>;
				#size-cells = <1>;
				ranges;

				ramoops: ramoops@0b000000 {
					compatible = "ramoops";
					reg = <0x0b000000 0x10000>; /* 64kB */
					record-size = <0x4000>; /* 16kB */
					console-size = <0>; /* disabled by default */
				};
			};
		};
	};

	__overrides__ {
		total-size = <&ramoops>,"reg:4";
		record-size = <&ramoops>,"record-size:0";
		console-size = <&ramoops>,"console-size:0";
	};
};
